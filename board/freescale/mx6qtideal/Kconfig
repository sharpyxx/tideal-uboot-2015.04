## board/freescale/mx6qtideal/Kconfig
```kconfig
if TARGET_MX6QTIDEAL

config SYS_BOARD
	default "mx6qtideal"

config SYS_VENDOR
	default "freescale"

config SYS_SOC
	default "mx6"

config SYS_CONFIG_NAME
	default "mx6qtideal"

endif
```

## configs/mx6q_tideal_defconfig
```kconfig
CONFIG_SYS_EXTRA_OPTIONS="IMX_CONFIG=board/freescale/mx6qtideal/mx6q_2g_k4b4g16b_byk0.cfg,MX6Q,ANDROID_SUPPORT"
CONFIG_ARM=y
CONFIG_TARGET_MX6QTIDEAL=y
CONFIG_SYS_MALLOC_F=y
CONFIG_SYS_MALLOC_F_LEN=0x400
CONFIG_DM=y
CONFIG_DM_THERMAL=y
```
